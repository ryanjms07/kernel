## common/drivers/cpufreq/Kconfig
```kconfig
config CPU_FREQ
	bool "CPU Frequency scaling"
	help
	  CPU Frequency scaling allows you to change the clock speed of 
	  CPUs on the fly. This is a nice method to save power, because 
	  the lower the CPU clock speed, the less power the CPU consumes.

	  Note that this driver doesn't automatically change the CPU
	  clock speed, you need to either enable a dynamic cpufreq governor
	  (see below) after boot, or use a userspace tool.

	  For details, take a look at <file:Documentation/cpu-freq>.

	  If in doubt, say N.

if CPU_FREQ

config CPU_FREQ_TABLE
	tristate

config CPU_FREQ_DEBUG
	bool "Enable CPUfreq debugging"
	help
	  Say Y here to enable CPUfreq subsystem (including drivers)
	  debugging. You will need to activate it via the kernel
	  command line by passing
	     cpufreq.debug=<value>

	  To get <value>, add 
	       1 to activate CPUfreq core debugging,
	       2 to activate CPUfreq drivers debugging, and
	       4 to activate CPUfreq governor debugging

config CPU_FREQ_STAT
	tristate "CPU frequency translation statistics"
	select CPU_FREQ_TABLE
	default y
	help
	  This driver exports CPU frequency statistics information through sysfs
	  file system.

	  To compile this driver as a module, choose M here: the
	  module will be called cpufreq_stats.

	  If in doubt, say N.

config CPU_FREQ_STAT_DETAILS
	bool "CPU frequency translation statistics details"
	depends on CPU_FREQ_STAT
	help
	  This will show detail CPU frequency translation table in sysfs file
	  system.

	  If in doubt, say N.

config BACEM_TWEAK
	tristate "bacem_tweak"

choice
	prompt "Default CPUFreq governor"
	default CPU_FREQ_DEFAULT_GOV_USERSPACE if CPU_FREQ_SA1100 || CPU_FREQ_SA1110
	default CPU_FREQ_DEFAULT_GOV_PERFORMANCE
	help
	  This option sets which CPUFreq governor shall be loaded at
	  startup. If in doubt, select 'performance'.

config CPU_FREQ_DEFAULT_GOV_PERFORMANCE
	bool "performance"
	select CPU_FREQ_GOV_PERFORMANCE
	help
	  Use the CPUFreq governor 'performance' as default. This sets
	  the frequency statically to the highest frequency supported by
	  the CPU.

config CPU_FREQ_DEFAULT_GOV_HOTPLUG
	bool "hotplug"
	select CPU_FREQ_GOV_HOTPLUG
	help
	  Use the CPUFreq governor 'performance' as default. This sets
	  the frequency statically to the highest frequency supported by
	  the CPU.

config CPU_FREQ_DEFAULT_GOV_POWERSAVE
	bool "powersave"
	depends on EMBEDDED
	select CPU_FREQ_GOV_POWERSAVE
	help
	  Use the CPUFreq governor 'powersave' as default. This sets
	  the frequency statically to the lowest frequency supported by
	  the CPU.

config CPU_FREQ_DEFAULT_GOV_USERSPACE
	bool "userspace"
	select CPU_FREQ_GOV_USERSPACE
	help
	  Use the CPUFreq governor 'userspace' as default. This allows
	  you to set the CPU frequency manually or when a userspace 
	  program shall be able to set the CPU dynamically without having
	  to enable the userspace governor manually.

config CPU_FREQ_DEFAULT_GOV_ONDEMAND
	bool "ondemand"
	select CPU_FREQ_GOV_ONDEMAND
	select CPU_FREQ_GOV_BCM21553
	help
	  Use the CPUFreq governor 'ondemand' as default. This allows
	  you to get a full dynamic frequency capable system by simply
	  loading your cpufreq low-level hardware driver.
	  Be aware that not all cpufreq drivers support the ondemand
	  governor. If unsure have a look at the help section of the
	  driver. Fallback governor will be the performance governor.

config CPU_FREQ_DEFAULT_GOV_INTERACTIVE
	bool "interactive"
	select CPU_FREQ_GOV_INTERACTIVE
	select CPU_FREQ_GOV_BCM21553
	help
	  Use the CPUFreq governor 'interactive' as default. This allows
	  you to get a full dynamic frequency capable system by simply
	  loading your cpufreq low-level hardware driver.
	  Be aware that not all cpufreq drivers support the interactive
	  governor. If unsure have a look at the help section of the
	  driver. Fallback governor will be the performance governor.

config CPU_FREQ_DEFAULT_GOV_CONSERVATIVE
	bool "conservative"
	select CPU_FREQ_GOV_CONSERVATIVE
	select CPU_FREQ_GOV_BCM21553
	help
	  Use the CPUFreq governor 'conservative' as default. This allows
	  you to get a full dynamic frequency capable system by simply
	  loading your cpufreq low-level hardware driver.
	  Be aware that not all cpufreq drivers support the conservative
	  governor. If unsure have a look at the help section of the
	  driver. Fallback governor will be the performance governor.


config CPU_FREQ_DEFAULT_GOV_SAKURACTIVE
	bool "sakuractive"
	select CPU_FREQ_GOV_SAKURACTIVE
	select CPU_FREQ_GOV_PERFORMANCE
	help
	  Use the CPUFreq governor 'conservative' as default. This allows
	  you to get a full dynamic frequency capable system by simply
	  loading your cpufreq low-level hardware driver.
	  Be aware that not all cpufreq drivers support the conservative
	  governor. If unsure have a look at the help section of the
	  driver. Fallback governor will be the performance governor.


config CPU_FREQ_DEFAULT_GOV_SMARTASS2
	bool "smartass2"
	select CPU_FREQ_GOV_SMARTASS2
	select CPU_FREQ_GOV_BCM21553
	help
	  Use the CPUFreq governor 'conservative' as default. This allows
	  you to get a full dynamic frequency capable system by simply
	  loading your cpufreq low-level hardware driver.
	  Be aware that not all cpufreq drivers support the conservative
	  governor. If unsure have a look at the help section of the
	  driver. Fallback governor will be the performance governor.

config CPU_FREQ_DEFAULT_GOV_VIRTOUS
	bool "virtous"
	select CPU_FREQ_GOV_VIRTOUS
	select CPU_FREQ_GOV_BCM21553
	help
	  Use the CPUFreq governor 'conservative' as default. This allows
	  you to get a full dynamic frequency capable system by simply
	  loading your cpufreq low-level hardware driver.
	  Be aware that not all cpufreq drivers support the conservative
	  governor. If unsure have a look at the help section of the
	  driver. Fallback governor will be the performance governor.

config CPU_FREQ_DEFAULT_GOV_WHEATLEY
	bool "wheatley"
	select CPU_FREQ_GOV_WHEATLEY
	select CPU_FREQ_GOV_BCM21553
	help
	  Use the CPUFreq governor 'conservative' as default. This allows
	  you to get a full dynamic frequency capable system by simply
	  loading your cpufreq low-level hardware driver.
	  Be aware that not all cpufreq drivers support the conservative
	  governor. If unsure have a look at the help section of the
	  driver. Fallback governor will be the performance governor.

config CPU_FREQ_DEFAULT_GOV_BCM21553
	bool "bcm21553"
	select CPU_FREQ_GOV_BCM21553
	help
	  Use the CPUFreq governor 'bcm21553' as default. This option enables
	  CPUFReq governor implemented for Broadcom BCM21553 chip. This
	  governor adjusts the cpu frequency and voltage based on certain
	  usecases.

config CPU_FREQ_DEFAULT_GOV_SAKURACTIVE
	bool "sakuractive"
	select CPU_FREQ_GOV_SAKURACTIVE
	help
	  Use the CPUFreq governor 'sakuractive' as default. This option enables
	  CPUFReq governor sakuractive.

config CPU_FREQ_DEFAULT_GOV_SAVAGEDZEN
	bool "savagedzen"
	select CPU_FREQ_GOV_SAVAGEDZEN
	help
	  Use the CPUFreq governor 'savagedzen' as default. This option enables
	  CPUFReq governor savagedzen.

config CPU_FREQ_DEFAULT_GOV_SCARY
	bool "scary"
	select CPU_FREQ_GOV_SCARY
	help
	  Use the CPUFreq governor 'scary' as default. This option enables
	  CPUFReq governor scary.

config CPU_FREQ_DEFAULT_GOV_SCARY
	bool "scary"
	select CPU_FREQ_GOV_SCARY
	help
	  Use the CPUFreq governor 'scary' as default. This option enables
	  CPUFReq governor scary.

config CPU_FREQ_DEFAULT_GOV_SMARTASS
	bool "smartass"
	select CPU_FREQ_GOV_SMARTASS
	help
	  Use the CPUFreq governor 'smartass' as default. This option enables
	  CPUFReq governor smartass.

config CPU_FREQ_DEFAULT_GOV_SMOOTHASS
	bool "smoothass"
	select CPU_FREQ_GOV_SMOOTHASS
	help
	  Use the CPUFreq governor 'smoothass' as default. This option enables
	  CPUFReq governor smartass.

config CPU_FREQ_DEFAULT_GOV_LIONHEART
	bool "lionheart"
	select CPU_FREQ_GOV_LIONHEART
	help
	  Use the CPUFreq governor 'lionheart' as default. This option enables
	  CPUFReq governor lionheart.

config CPU_FREQ_DEFAULT_GOV_LAZY
	bool "lazy"
	select CPU_FREQ_GOV_LAZY
	help
	  Use the CPUFreq governor 'lazy' as default. This option enables
	  CPUFReq governor lazy.


config CPU_FREQ_DEFAULT_GOV_LULZACTIVE2
	bool "lulzactive2"
	select CPU_FREQ_GOV_LULZACTIVE2
	help
	  Use the CPUFreq governor 'lulzactive2' as default. This option enables
	  CPUFReq governor lulzactive.


config CPU_FREQ_DEFAULT_GOV_BADASS
	bool "badass"
	select CPU_FREQ_GOV_BADASS
	select CPU_FREQ_GOV_PERFORMANCE
	---help---
	Use the CPUFreq governor 'badass' as default. This allows
	you to get a full dynamic frequency capable system by simply
	loading your cpufreq low-level hardware driver.
	Be aware that not all cpufreq drivers support the badass
	governor. If unsure have a look at the help section of the
	driver. Fallback governor will be the performance governor.

config CPU_FREQ_DEFAULT_GOV_LAGFREE
	bool "lagfree"
	select CPU_FREQ_GOV_LAGFREE
	select CPU_FREQ_GOV_PERFORMANCE
	---help---
	Use the CPUFreq governor 'lagfree' as default. This allows
	you to get a full dynamic frequency capable system by simply
	loading your cpufreq low-level hardware driver.
	Be aware that not all cpufreq drivers support the lagfree
	governor. If unsure have a look at the help section of the
	driver. Fallback governor will be the performance governor.


endchoice

config CPU_FREQ_GOV_PERFORMANCE
	tristate "'performance' governor"
	help
	  This cpufreq governor sets the frequency statically to the
	  highest available CPU frequency.

	  To compile this driver as a module, choose M here: the
	  module will be called cpufreq_performance.

	  If in doubt, say Y.

config CPU_FREQ_GOV_HOTPLUG
	tristate "'hotplug' governor"
	help
	  This cpufreq governor sets the frequency statically to the
	  highest available CPU frequency.

	  To compile this driver as a module, choose M here: the
	  module will be called cpufreq_performance.

	  If in doubt, say Y.

config CPU_FREQ_GOV_POWERSAVE
	tristate "'powersave' governor"
	help
	  This cpufreq governor sets the frequency statically to the
	  lowest available CPU frequency.

	  To compile this driver as a module, choose M here: the
	  module will be called cpufreq_powersave.

	  If in doubt, say Y.

config CPU_FREQ_GOV_USERSPACE
	tristate "'userspace' governor for userspace frequency scaling"
	help
	  Enable this cpufreq governor when you either want to set the
	  CPU frequency manually or when a userspace program shall
	  be able to set the CPU dynamically, like on LART 
	  <http://www.lartmaker.nl/>.

	  To compile this driver as a module, choose M here: the
	  module will be called cpufreq_userspace.

	  For details, take a look at <file:Documentation/cpu-freq/>.

	  If in doubt, say Y.

config CPU_FREQ_GOV_ONDEMAND
	tristate "'ondemand' cpufreq policy governor"
	select CPU_FREQ_TABLE
	help
	  'ondemand' - This driver adds a dynamic cpufreq policy governor.
	  The governor does a periodic polling and 
	  changes frequency based on the CPU utilization.
	  The support for this governor depends on CPU capability to
	  do fast frequency switching (i.e, very low latency frequency
	  transitions). 

	  To compile this driver as a module, choose M here: the
	  module will be called cpufreq_ondemand.

	  For details, take a look at linux/Documentation/cpu-freq.

	  If in doubt, say N.

config CPU_FREQ_GOV_INTERACTIVE
	tristate "'interactive' cpufreq policy governor"
	select CPU_FREQ_TABLE
	help
	  'interactive' - This driver adds a dynamic cpufreq policy governor.
	  The governor does a periodic polling and 
	  changes frequency based on the CPU utilization.
	  The support for this governor depends on CPU capability to
	  do fast frequency switching (i.e, very low latency frequency
	  transitions). 

	  To compile this driver as a module, choose M here: the
	  module will be called cpufreq_interactive.

	  For details, take a look at linux/Documentation/cpu-freq.

	  If in doubt, say N.

config CPU_FREQ_GOV_CONSERVATIVE
	tristate "'conservative' cpufreq governor"
	depends on CPU_FREQ
	help
	  'conservative' - this driver is rather similar to the 'ondemand'
	  governor both in its source code and its purpose, the difference is
	  its optimisation for better suitability in a battery powered
	  environment.  The frequency is gracefully increased and decreased
	  rather than jumping to 100% when speed is required.

	  If you have a desktop machine then you should really be considering
	  the 'ondemand' governor instead, however if you are using a laptop,
	  PDA or even an AMD64 based computer (due to the unacceptable
	  step-by-step latency issues between the minimum and maximum frequency
	  transitions in the CPU) you will probably want to use this governor.

	  To compile this driver as a module, choose M here: the
	  module will be called cpufreq_conservative.

	  For details, take a look at linux/Documentation/cpu-freq.

	  If in doubt, say N.



config CPU_FREQ_GOV_SAKURACTIVE
	tristate "'sakuractive' cpufreq policy governor"
	depends on CPU_FREQ
	help
	  'sakuractive' - This driver adds a dynamic cpufreq policy governor.
	  The governor does a periodic polling and 
	  changes frequency based on the CPU utilization.
	  The support for this governor depends on CPU capability to
	  do fast frequency switching (i.e, very low latency frequency
	  transitions). 

	  To compile this driver as a module, choose M here: the
	  module will be called cpufreq_interactive.

	  For details, take a look at linux/Documentation/cpu-freq.

	  If in doubt, say N.

config CPU_FREQ_GOV_SMARTASS2
	tristate "'smartass_v2' cpufreq policy governor"
	depends on CPU_FREQ
	help
	  'smartass v2' - This driver adds a dynamic cpufreq policy governor.

config CPU_FREQ_GOV_VIRTOUS
	tristate "'virtous' cpufreq policy governor"
	depends on CPU_FREQ
	help
	  'virtous' - This driver adds a dynamic cpufreq policy governor.

config CPU_FREQ_GOV_WHEATLEY
	tristate "'wheatley' cpufreq policy governor"
	depends on CPU_FREQ
	help
	  'wheatley' - This driver adds a dynamic cpufreq policy governor.



config CPU_FREQ_GOV_LIONHEART
	tristate "'lionheart' cpufreq policy governor"
	depends on CPU_FREQ
	help
	  'lionheart' - This driver adds..

config CPU_FREQ_GOV_LAZY
	tristate "'lazy' cpufreq policy governor"
	depends on CPU_FREQ
	help
	  'lazy' - This driver adds laz..


config CPU_FREQ_GOV_LAGFREE
	tristate "'lagfree' cpufreq policy governor"
	depends on CPU_FREQ
	help
	  'lagfree' - This driver adds laz..

config CPU_FREQ_GOV_SMOOTHASS
	tristate "'smoothass' cpufreq policy governor"
	depends on CPU_FREQ
	help
	  'smoothass' - This driver adds laz..

config CPU_FREQ_GOV_SMARTASS
	tristate "'smartass' cpufreq policy governor"
	depends on CPU_FREQ
	help
	  'smartass' - This driver adds laz..

config CPU_FREQ_GOV_SCARY
	tristate "'scary' cpufreq policy governor"
	depends on CPU_FREQ
	help
	  'scary' - This driver adds laz..

config CPU_FREQ_GOV_SAVAGEDZEN
	tristate "'savagedzen' cpufreq policy governor"
	depends on CPU_FREQ
	help
	  'savagedzen' - This driver adds laz..

config CPU_FREQ_GOV_SAKURACTIVE
	tristate "'sakuractive' cpufreq policy governor"
	depends on CPU_FREQ
	help
	  'sakuractive' - This driver adds laz..


config CPU_FREQ_GOV_BADASS
	tristate "'badass' cpufreq policy governor"
	depends on CPU_FREQ
	help
	  'badass' - This driver adds laz..

config CPU_FREQ_GOV_LULZACTIVE2
	tristate "'lulzactive2' cpufreq policy governor"
	depends on CPU_FREQ
	help
	  'lulzactive2' - This driver adds...........



endif	# CPU_FREQ
```
